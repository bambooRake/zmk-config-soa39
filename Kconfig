## Kconfig
```kconfig
DT_COMPAT_ZMK_INPUT_PROCESSOR_POINTER_INERTIA := zmk,input-processor-pointer-inertia

config ZMK_INPUT_PROCESSOR_POINTER_INERTIA
    bool "Pointer (cursor) inertia / coasting input processor"
    default $(dt_compat_enabled,$(DT_COMPAT_ZMK_INPUT_PROCESSOR_POINTER_INERTIA))
    depends on ZMK_POINTING
    depends on INPUT
    help
      ボールを速く動かして止めた直後、カーソルを減衰させながら少しだけ
      滑らせる入力プロセッサ。ゆっくり動かしている間は発動しない。

config ZMK_INPUT_PROCESSOR_POINTER_INERTIA_INIT_PRIORITY
    int "Pointer inertia input processor init priority"
    depends on ZMK_INPUT_PROCESSOR_POINTER_INERTIA
    default 90

DT_COMPAT_ZMK_INPUT_PROCESSOR_AXIS_LOCK := zmk,input-processor-axis-lock

config ZMK_INPUT_PROCESSOR_AXIS_LOCK
    bool "Axis lock input processor"
    default $(dt_compat_enabled,$(DT_COMPAT_ZMK_INPUT_PROCESSOR_AXIS_LOCK))
    depends on ZMK_POINTING
    depends on INPUT
    help
      ジェスチャの動き出しで縦/横を確定し、そのジェスチャの間その軸に
      固定する入力プロセッサ。

config ZMK_INPUT_PROCESSOR_AXIS_LOCK_INIT_PRIORITY
    int "Axis lock input processor init priority"
    depends on ZMK_INPUT_PROCESSOR_AXIS_LOCK
    default 90
```

## dts/bindings/zmk,input-processor-axis-lock.yaml
```yaml
description: |
  Axis lock input processor.

  ジェスチャの動き出しで縦か横かを決め、そのジェスチャが終わる
  (release-ms 無入力になる) までその軸に固定する。もう一方の軸はゼロにする。

  xy_clipper の置き換えとして、スクロールマッパーより前に置くこと。
  出力量は accum / threshold で、xy_clipper と同じ計算。

compatible: "zmk,input-processor-axis-lock"

include: ip_zero_param.yaml

properties:
  threshold:
    type: int
    default: 20
    description: |
      この蓄積量(生カウント)で 1 単位を出力する。大きいほどスクロールが
      粗く・鈍くなる。軸を確定する判定にも同じ値を使う。

  release-ms:
    type: int
    default: 200
    description: |
      この時間 入力が途切れたらジェスチャ終了とみなし、軸固定を解除する。
      短すぎるとスクロール中に軸が外れ、長すぎると縦の直後に横へ
      切り替えにくくなる。

  y-bias:
    type: int
    default: 1000
    description: |
      軸を決める時の Y(縦)の優遇度(x1000)。1000 = 優遇なしで、
      純粋に動き出しの移動量が大きい方が勝つ。縦を出やすくしたい場合は
      1200 などに上げる (参考: xy_clipper は 2000 相当の固定優遇だった)。
```

## dts/bindings/zmk,input-processor-pointer-inertia.yaml
```yaml
description: |
  Pointer (cursor) inertia / coasting input processor.

  ボールを速く動かして止めた直後、カーソルを減衰させながら少しだけ滑らせる。
  ゆっくり動かしている間は min-speed ゲートで発動しないため、精密操作の
  邪魔にならない。

  加速プロセッサより後ろに置くこと。惰性の速度が画面上の見た目の速度と
  一致する (加速前の生カウントで滑らせると、離した瞬間に急減速して見える)。

compatible: "zmk,input-processor-pointer-inertia"

include: ip_zero_param.yaml

properties:
  tick-ms:
    type: int
    default: 16
    description: |
      惰性の出力周期(ms)。同時に「この時間だけ実イベントが途切れたら
      ボールが止まった」と判定する猶予でもある。センサーのレポート間隔
      (CONFIG_PMW3610_ALT_REPORT_INTERVAL_MIN) と揃えるのが基本。

  duration-ms:
    type: int
    default: 200
    description: 惰性の最大継続時間(ms)。ここに達したら速度が残っていても打ち切る。

  decay:
    type: int
    default: 790
    description: |
      tick ごとの減衰率(x1000)。790 は tick=16ms のとき 200ms で初速の約5%
      まで落ちる値。大きくするほど長く滑る。

  min-speed:
    type: int
    default: 800
    description: |
      惰性を発動する最低速度(counts/sec)。これ未満で止めた場合は滑らない。
      上流に加速プロセッサがある場合、ここでの速度は加速後の値なので注意。

  stop:
    type: int
    default: 300
    description: |
      終了判定のしきい値。単位は「1 tick あたりの移動カウント x 1000」。
      300 = 0.3 カウント/tick。

  smoothing:
    type: int
    default: 600
    description: |
      速度推定の EMA における新サンプルの重み(x1000)。大きいほど直近の
      動きに追従し、小さいほど滑らかだが反応が鈍る。
```
